// /**
//  * @author Maksym Palii
//  * @brief TWI (I2C) with SHT3x Single Shot Data Acquisition Mode, NO clock stretching 
//  * (https://sensirion.com/media/documents/213E6A3B/63A5A569/Datasheet_SHT3x_DIS.pdf)
//  * @version 1.0
//  * @date 2024 August 24
//  */

// #define F_CPU           (16000000UL)
// #define DEVICE_ADDRESS  (0x88)      // TWI scanner shows 00 and 88 as valid addresses
// #define CMD_RL_CSD      (0x2416)    // Repeatability Low (RL) with Clock Stretching DISABLED (CSD)
 
// #include "drivers/gpio.h"
// #include "drivers/i2c.h"
// #include "drivers/uart644.h"
// #include <util/delay.h>

// void initialize(void);
// void print_i2c_status(void);
// void init_sht3x(void);
// struct SHT3xResult read_sht3x(void);
// void print_sht3x_result(struct SHT3xResult result);

// struct SHT3xResult
// {
//     uint16_t raw_temperature;
//     uint8_t temperature_crc;
//     uint16_t raw_humidity;
//     uint8_t humidity_crc;
// };

// int main(void) 
// {
//     initialize();
//     printf("Temperature/humidity sensor SHT3X example\r\n\r\n");

//     print_i2c_status();

//     // printf("1. Configure SHT3X with Single Shot Data Acquisition Mode no clock stretching:\r\n\r\n");
//     init_sht3x();
//     // printf("2. Init measurement and read results:\r\n\r\n");
//     struct SHT3xResult measurement_result = read_sht3x();
//     printf("3. Measurement results:\r\n\r\n");
//     print_sht3x_result(measurement_result);

//     while (true)
//     {
//         // NOP
//     }
// }

// void initialize(void)
// {
//     init_gpio();
//     stdin = stdout = stderr = init_uart(F_CPU, 9600, false);
//     init_i2c();
// }

// void print_i2c_status(void)
// {
//     uint8_t i2c_status = i2c_get_status();
//     printf("======= TWSR:0x%02X\r\n\r\n", i2c_status);
// }


// void init_sht3x(void)
// {
//     /**
//      * Single Shot Data Acquisition Mode
//      */
//     // START
//     // printf("\tSTART\r\n");
//     i2c_start();
//     // print_i2c_status();

//     // DEVICE ADDRESS + WRITE
//     // printf("\tDEVICE ADDRESS + WRITE\r\n");
//     i2c_set_data(DEVICE_ADDRESS & WRITE_BIT_MASK);
//     i2c_continue_no_ack();
//     // print_i2c_status();

//     // COMMAND (MSB)
//     // printf("\tCOMMAND (MSB)\r\n");
//     i2c_set_data(CMD_RL_CSD >> 8);
//     i2c_continue_no_ack();
//     // print_i2c_status();

//     // COMMAND (LSB)
//     // printf("\tCOMMAND (LSB)\r\n");
//     i2c_set_data(CMD_RL_CSD & 0xFF);
//     i2c_continue_no_ack();
//     // print_i2c_status();

//     // STOP
//     // printf("\tSTOP\r\n");
//     i2c_stop();
//     // print_i2c_status();
// }

// struct SHT3xResult read_sht3x(void)
// {
//     struct SHT3xResult result;

//     /** 
//      * Measurement
//      */
//     // waiting for the conversion result
//     uint8_t poll_counter = 0;
//     while (true)
//     {
//         poll_counter++;

//         // START
//         // printf("\tSTART\r\n");
//         i2c_start();
//         // print_i2c_status();

//         // DEVICE ADDRESS + READ
//         // printf("\tDEVICE ADDRESS + READ\r\n");
//         i2c_set_data(DEVICE_ADDRESS | READ_BIT_MASK);
//         i2c_continue_no_ack();
//         // print_i2c_status();

//         if (i2c_get_status() == 0x40)   // if ACK has been returned then break the loop
//         {
//             printf("\tSENSOR POLLING COUNTER: %d\r\n", poll_counter);
//             break;
//         }

//         // STOP
//         // printf("\tSTOP\r\n");
//         i2c_stop();
//         // print_i2c_status();
//     }

//     // TEMPERATURE MSB
//     printf("\tTEMPERATURE MSB\r\n");
//     i2c_continue_ack();
//     print_i2c_status();
//     result.raw_temperature = i2c_get_data() << 8;

//     // TEMPERATURE LSB
//     printf("\tTEMPERATURE LSB\r\n");
//     i2c_continue_ack();
//     print_i2c_status();
//     result.raw_temperature |= i2c_get_data();

//     // TEMPERATURE CRC
//     printf("\tTEMPERATURE CRC\r\n");
//     i2c_continue_ack();
//     print_i2c_status();
//     result.temperature_crc = i2c_get_data();

//     // HUMIDITY MSB
//     printf("\tHUMIDITY MSB\r\n");
//     i2c_continue_ack();
//     print_i2c_status();
//     result.raw_humidity = i2c_get_data() << 8;

//     // HUMIDITY LSB
//     printf("\tHUMIDITY LSB\r\n");
//     i2c_continue_ack();
//     print_i2c_status();
//     result.raw_humidity |= i2c_get_data();

//     // HUMIDITY CRC
//     printf("\tHUMIDITY CRC\r\n");
//     i2c_continue_no_ack();
//     print_i2c_status();
//     result.humidity_crc = i2c_get_data();

//     // STOP
//     printf("\tSTOP\r\n");
//     i2c_stop();
//     print_i2c_status();

//     return result;
// }

// void print_sht3x_result(struct SHT3xResult result)
// {
//     // results
//     int8_t converted_temperature = (int8_t) ((int32_t) 175 * result.raw_temperature / 0xFFFF) - 45;
//     int8_t converted_humidity = (int8_t) ((int32_t) 100 * result.raw_humidity / 0xFFFF);

//     printf("Raw temperature: 0x%4X, crc: 0x%X\r\n", result.raw_temperature, result.temperature_crc);
//     printf("Converted temperature: %dºC\r\n", converted_temperature);
//     printf("Raw humidity: 0x%4X, crc: 0x%X\r\n", result.raw_humidity, result.humidity_crc);
//     printf("Converted humidity: %d%%\r\n", converted_humidity);
// }




/*
 * Lesson_37.c
 *
 * Created: 20.12.2021 19:46:15
 * Author : Дмитрий
 */ 

#define F_CPU 16000000UL
#include <avr/io.h>
#include <util/delay.h>
#include <avr/interrupt.h>
#include <avr/pgmspace.h>

unsigned int r1_1000, r2_100=0, r3_10=0,  r4_1=0;


unsigned char TWI_status = 0;

int temper = 4598;


// Standard ASCII 5x8 font
const uint8_t font_5x8[] PROGMEM = {

    0x00,0x00,0x00,0x00,0x00,0x00,0x00,0x00,  // <space>
    0x00,0x00,0x00,0x00,0x5f,0x00,0x00,0x00,  // !
    0x00,0x00,0x00,0x03,0x00,0x03,0x00,0x00,  // "
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	0x48, 0x54, 0x34, 0x14, 0x7C    // я 0xFF 255
};





// Разбивка числа на разряды
void chislo (unsigned int chislo_z)
{
	r1_1000 = chislo_z/1000;
	r2_100 = chislo_z%1000/100;
	r3_10 = chislo_z%100/10;
	r4_1 = chislo_z%10;
}



// Настройки TWI
void TWI_settings (void)
{
	TWBR = 2; // Частота 50 кГц линии тактирования при fмк = 1 МГц
	TWSR &= ~((1<<TWPS1) | (1<<TWPS0)); // Коэф. деления = 1
}


// Старт TWI
void TWI_start (void)
{
	TWCR = (1<<TWINT) | (1<<TWSTA) | (1<<TWEN);
	while (!(TWCR&(1<<TWINT)))
	;
}


// Стоп TWI
void TWI_stop (void)
{
	TWCR = (1<<TWINT) | (1<<TWSTO) | (1<<TWEN);
}


// Передача адреса
void TWI_addres (void)
{
	TWDR=0b01111000;// Адрес + W / или 0b01111010
	TWCR=(1<<TWINT)|(1<<TWEN);
	while(!(TWCR & (1<<TWINT)))
	;
}


// Передача данных TWI
void TWI_data (uint8_t data)
{
	TWDR = data;
	TWCR = (1<<TWINT) | (1<<TWEN);
	while (!(TWCR&(1<<TWINT)))
	;
}


// Передача команд TWI
void TWI_command (uint8_t command)
{
	TWDR = 0b10000000; // Контрольный байт
	TWCR = (1<<TWINT) | (1<<TWEN);
	while (!(TWCR&(1<<TWINT)))
	;
	
	TWDR = command; // Команда
	TWCR = (1<<TWINT) | (1<<TWEN);
	while (!(TWCR&(1<<TWINT)))
	;

}


// Массив команд инициализации
const uint8_t init[] PROGMEM =
{
	0xA8, // Установить multiplex ratio

	0x3F, // 1/64 duty (значение по умолчанию), 0x1F - 128x32, 0x3F - 128x64
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	0xA1, // Режим разверки по странице (по X)
	// A1 - нормальный режим (слева/направо) A0 - обратный (справа/налево)
	0xC8, // Режим сканирования озу дисплея
	// для изменения системы координат
	// С0 - снизу/верх (начало нижний левый угол)
	// С8 - сверху/вниз (начало верний левый угол)
	0xDA, // Аппаратная конфигурация COM
	0x12, // 0x02 - 128x32, 0x12 - 128x64
	0x81, // Установка яркости дисплея
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	0x80, //+----- делитель 0-F/ 0 - деление на 1
	//+------ частота генератора. по умочанию 0x80
	0x8D, // Управление внутреним преобразователем
	0x14, // 0x10 - отключить (VCC подается извне) 0x14 - запустить внутрений DC/DC
	0xAF // Дисплей включен
};

// Функция инициализации дисплея
void display_init (void)
{
	for (uint8_t i = 0; i < sizeof init; i++)
	{
		TWI_command(pgm_read_byte(&init[i]));
	}
}


// Функция вывода символа 5*8
void print_char(uint8_t char_1)
{
	if ((char_1 >= 32) && (char_1 <= 127))
	{
		char_1 = char_1 - 32; // Смещение в таблице ASCII [32...127]	
	} 
	 else if (char_1 >= 192)
	{
		char_1 = char_1 - 96; // Смещение в таблице CP1251 [192...255]	
	}
	else char_1 = 85; //  Для экономии памяти остальные игнорируются, так как они отстутствуют в таблице
	
	for (uint8_t i = 0; i < 8; i++)
	{
		TWI_data(pgm_read_byte(&font_5x8[8*char_1 + i]));
	}
}



// Функция вывода строки 5*8
void print_string(char *str)
{
	while( *str)
	{
		print_char(*str++);
	}
}



int main(void)
{
    sei();
    
    TWI_settings();
    TWI_start();
    TWI_addres();
	
	display_init();
	
	// Очистка дисплея
	TWI_command(0x21); // Установка столбца
	TWI_command(0); // Начальный столбец
	TWI_command(127); // Конечный столбец
	TWI_command(0x22); // Установка (строки)страницы PAGE
	TWI_command(0); // Начальая страница
	TWI_command(7); // Конечная страница
	
	TWDR = 0b01000000; // Указываем, что следующиим будут байтЫ данных
	TWCR = (1<<TWINT) | (1<<TWEN);
	while (!(TWCR&(1<<TWINT)))
	;
	
	for(int i = 0; i < 1024; i++)
	{
		TWI_data(0);
	}
	
	
// 	1
// 		TWI_data(0b00000000);
// 		TWI_data(0b00000100);
// 		TWI_data(0b00000010);	
// 		TWI_data(0b11111111);
// 		TWI_data(0b00000000);
// 		
// 		// 2
// 		TWI_data(0);  // 0ая колонка
// 	TWI_data(0b00111010	);  // 1ая колонка
// 	TWI_data(0b00101010	);  // 2ая колонка
// 	TWI_data(0b00101110	);  // 3ая колонка


/*
// с 0xF1 241
TWI_data(0x38);
TWI_data(0x44);
TWI_data(0x44);
TWI_data(0x44);
TWI_data(0x00);

// Пробел
TWI_data(0b00000000);
TWI_data(0b00000000);
TWI_data(0b00000000);
TWI_data(0b00000000);
TWI_data(0b00000000);

// т 0xF2 242
TWI_data(0x04);
TWI_data(0x04);
TWI_data(0x7C);
TWI_data(0x04);
TWI_data(0x04);

// Пробел
TWI_data(0b00000000);
TWI_data(0b00000000);
TWI_data(0b00000000);
TWI_data(0b00000000);
TWI_data(0b00000000);

 // у 0xF3 243
 TWI_data(0x0C);
 TWI_data(0x50);
 TWI_data(0x50);
 TWI_data(0x50);
 TWI_data(0x3C);
  
 // Пробел
 TWI_data(0b00000000);
 TWI_data(0b00000000);
 TWI_data(0b00000000);
 TWI_data(0b00000000);
 TWI_data(0b00000000);
 
 
   
 // ф 0xF4 244
 TWI_data(0x08);
 TWI_data(0x14);
 TWI_data(0x7C);
 TWI_data(0x14);
 TWI_data(0x08);

// Пробел
TWI_data(0b00000000);
TWI_data(0b00000000);
TWI_data(0b00000000);
TWI_data(0b00000000);
TWI_data(0b00000000);

*/


// print_char('D');
// print_char(' ');
// print_char('b');
// print_char(' ');
// print_char('l');
// print_char(' ');


print_string("Note that the bit rates are quoted for the transfers between controller" 
            // "(master) and target (slave) without clock stretching..."
            // " the target device, as well as per-byte ACK/NACK bits. Thus the actual transfer r"
            // "ate of user data is lower than those peak bit rates alone would imply. For exampl"
            // "e, if each interaction with a target inefficiently allows only 1 byte of data to "
            // "be transferred, the data rate will be less than half the peak bit rate."
            );


// chislo(temper);

// print_char(r1_1000 + '0');
// print_char(r2_100 + '0');
// print_char(r3_10 + '0');
// print_char(r4_1 + '0');

TWI_stop();

	
    while (1) 
    {
    }
}
